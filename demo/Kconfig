## demo/Kconfig
```kconfig
# SPDX-License-Identifier: GPL-2.0
menu "Demo Code"

config DEMO_HELLOWORLD_MODULE
	tristate "DEMO_HELLOWORLD module"
	default y
	---help---
	  Enable support for various drivers needed on the Android platform

config CHARDEV_IOCTL_DEMO_MODULE
    tristate "chardev_ioctl_demo"
    default m
    ---help---
        chardev_ioctl_demo

config MY_MMAP_DEVICE_DEMO_MODULE
    tristate "my_mmap_device"
    default m
    ---help---
        my_mmap_device
endmenu
```
